## soc/ti/mspm0/mspm0l122x_l222x/Kconfig.defconfig.mspm0l222x
```kconfig
# TI MSPM0L222X SoC

# Copyright (c) 2024 Texas Instruments
# SPDX-License-Identifier: Apache-2.0

if SOC_MSPM0L222X

config SOC
	default "mspm0l222x"

config SYS_CLOCK_HW_CYCLES_PER_SEC
	default 32000000

config NUM_IRQS
	default 32

endif # SOC_MSPM0L222X
```
