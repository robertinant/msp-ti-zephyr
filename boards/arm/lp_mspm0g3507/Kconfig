## boards/arm/lp_mspm0g3507/Kconfig.board
```kconfig
# TI LP_MSPM0G3507 Development Board

# Copyright (c) 2024 Texas Instruments
# SPDX-License-Identifier: Apache-2.0

config BOARD_LP_MSPM0G3507
	bool "TI LP_MSPM0G3507"
	depends on SOC_MSPM0G3507
```

## boards/arm/lp_mspm0l2228/Kconfig.board
```kconfig
# TI LP_MSPM0L2228 Development Board

# Copyright (c) 2024 Texas Instruments
# SPDX-License-Identifier: Apache-2.0

config BOARD_LP_MSPM0L2228
	bool "TI LP_MSPM0L2228"
	depends on SOC_MSPM0L2228
```

## boards/arm/lp_mspm0l2228/Kconfig.defconfig
```kconfig
# TI LP_MSPM0L2228 development board configuration

# Copyright (c) 2024 Texas Instruments
# SPDX-License-Identifier: Apache-2.0

config BOARD
	default "lp_mspm0l2228"
	depends on BOARD_LP_MSPM0L2228
```

## boards/st/stm32l1_disco/stm32l152c_disco_defconfig
```kconfig
# SPDX-License-Identifier: Apache-2.0

# enable uart driver
CONFIG_SERIAL=y

#enable spi driver
CONFIG_SPI=y

# enable console
CONFIG_CONSOLE=y
CONFIG_UART_CONSOLE=y

# enable GPIO
CONFIG_GPIO=y
```

## boards/ti/lp_mspm0g3507/lp_mspm0g3507_defconfig
```kconfig
# SPDX-License-Identifier: Apache-2.0

CONFIG_CORTEX_M_SYSTICK=y

# Enable gpio driver
CONFIG_GPIO=y

# Enable uart driver
CONFIG_SERIAL=y

# Enable I2C
CONFIG_I2C=y

# Enable console
CONFIG_CONSOLE=y
CONFIG_UART_CONSOLE=y

# Enable pinctrl
CONFIG_PINCTRL=y

# Enable Clock Control
CONFIG_CLOCK_CONTROL=y

# Enable flash
CONFIG_FLASH=y
CONFIG_STREAM_FLASH=y
```

## drivers/clock_control/Kconfig.mspm0
```kconfig
# TI MSPM0 Family

# Copyright (c) 2024, Texas Instruments Inc.
# SPDX-License-Identifier: Apache-2.0

config CLOCK_CONTROL_MSPM0
	bool "TI MSPM0 clock"
	default y
	depends on DT_HAS_TI_MSPM0_CLOCK_CONTROL_ENABLED
	help
	  This option enables the TI MSPM0 Clock Control Enabler

config CLOCK_CONTROL_MSPM0_USE_PLL
	bool "TI MSPM0 Use PLL" 
	default n 
	help 
	  This option enables the PLL on MSPM0 devices (if equipped)
	
```

## drivers/flash/Kconfig.mspm0
```kconfig
# SPDX-License-Identifier: Apache-2.0
# Copyright (c) 2024 Texas Instruments

config SOC_FLASH_MSPM0
	bool "MSPM0 Flash driver"
	default y
	depends on DT_HAS_TI_MSPM0_FLASH_CONTROLLER_ENABLED
	help
	  This option enables the TI MSPM0 Flash driver.
```

## drivers/lin/Kconfig.mspm0
```kconfig
# SPDX-License-Identifier: Apache-2.0
# Copyright (c) 2024 Texas Instruments

config LIN_MSPM0
	bool "MSPM0 LIN protocol over UART driver"
	default y
	depends on DT_HAS_TI_MSPM0_UART_ENABLED
	help
	  This option enables the TI MSPM0 LIN UART driver.
```

## drivers/pinctrl/Kconfig.mspm0g3xxx
```kconfig
# SPDX-License-Identifier: Apache-2.0
# Copyright (c) 2024 Texas Instruments

config PINCTRL_MSPM0G3XXX
	bool "TI pinctrl MSPM0G3XXX driver"
	default y
	depends on DT_HAS_TI_MSPM0G3XXX_PINCTRL_ENABLED
	help
	  Enable support for the PINCTRL on TI MSPM0G3XXX series.
```

## dts/bindings/adc/ti,mspm0g3xxx-adc.yaml
```yaml
description: TI MSPM0G3XXX ADC

compatible: "ti,mspm0g3xxx-adc"

include: [adc-controller.yaml]

properties:
  reg:
    required: true

  interrupts:
    required: true

  "#io-channel-cells":
    const: 1
  
  ti,clk-source:
    type: int
    required: true
    enum:
      - 0 # ULPCLK is the source of ADC sample clock
      - 1 # SYSOSC is the source of ADC sample clock
    description: |
      ADC clock source :
      - <ULPCLK> : derived from ULPCLK
      - <SYSOSC> : derived from SYSOSC

  ti,clk-divider:
    type: int
    required: true
    enum:
      - 1 # clock is not divided
      - 2
      - 4
      - 8
      - 16
      - 24
      - 32
      - 48
    description: |
      Sample clock divider:
      Applies to the ti,adc-clock-src.

io-channel-cells:
  - input
```

## dts/bindings/clock/ti,mspm0-pll.yaml
```yaml
# Copyright (c) 2024 Texas Instruments Inc.
# SPDX-License-Identifier: Apache-2.0

description: TI MSPM0 Phase Locked Loop

compatible: "ti,mspm0-pll"

include: [clock-controller.yaml, base.yaml]

properties:
  clocks:
    required: true
    description: |
      Clock reference source

  "#clock-cells": 
    const: 0

  p-div: 
    type: int
    required: true
    enum:
      - 1
      - 2
      - 4
      - 8
    description: |
      pdiv

  q-div: 
    type: int
    required: true
    description: |
      qdiv
      Valid Range: 2 - 128

  clk0-div:
    type: int
    required: false
    description: |
      Valid Range: 1 - 16

  clk1-div:
    type: int
    required: false
    description: |
      Valid Range: 1 - 16

  clk2X-div:
    type: int
    required: false
    description: |
      Valid Range: 1 - 16
```

## dts/bindings/i2c/ti,mspm0g3xxx-i2c.yaml
```yaml
# SPDX-License-Identifier: Apache-2.0

description: TI MSPM0G3XXX I2C

compatible: "ti,mspm0g3xxx-i2c"

include: [i2c-controller.yaml, pinctrl-device.yaml, base.yaml]

properties:
  reg:
    required: true

  interrupts:
    required: true

  pinctrl-0:
    required: true

  pinctrl-1:
    required: false

  pinctrl-names:
    required: true
```

## dts/bindings/lin/ti,mspm0-lin.yaml
```yaml
# SPDX-License-Identifier: Apache-2.0

description: Virtual LIN UART driver

compatible: "virtual,lin-uart"

include: lin-controller.yaml

include: [lin-controller.yaml, pinctrl-device.yaml, base.yaml]


properties:
    max-wait-percent:
      type: int
      default: 140
      description: Duration as percent of nominal transmission time to allow space between bytes (LIN 2.2A spec is 40% additional)






description: TI MSPM0 LIN

compatible: "ti,mspm0-lin"

include: [uart-controller.yaml, pinctrl-device.yaml, base.yaml]

properties:
  reg:
    required: true

  interrupts:
    required: true

  pinctrl-0:
    required: true

  pinctrl-names:
    required: true
```

## samples/boards/ti/mspm0g3xxx/i2c/sample.yaml
```yaml
sample:
  name: I2C Controller RW Multibyte FIFO Poll for TI MSPM0G3XXX
tests:
  sample.boards.ti.mspm0g3507.i2c:
    build_only: true
    platform_allow: lp_mspm0g3507
    tags: i2c
```

## soc/arm/ti_mspm0/Kconfig.defconfig
```kconfig
# SPDX-License-Identifier: Apache-2.0
# Copyright (c) 2024 Texas Instruments

source "soc/arm/ti_mspm0/*/Kconfig.defconfig.series"
```

## soc/arm/ti_mspm0/Kconfig.soc
```kconfig
# Texas Instruments MSPM0 Family

# Copyright (c) 2024 Texas Instruments
# SPDX-License-Identifier: Apache-2.0

source "soc/arm/ti_mspm0/*/Kconfig.series"
```

## soc/arm/ti_mspm0/mspm0l2xxx/Kconfig.defconfig.mspm0l2228
```kconfig
# TI MSPM0L2228 SoC

# Copyright (c) 2024 Texas Instruments
# SPDX-License-Identifier: Apache-2.0

if SOC_MSPM0L2228

config SOC
	default "mspm0l2228"

config SYS_CLOCK_HW_CYCLES_PER_SEC
	default 32000000

config NUM_IRQS
	default 32

endif # SOC_MSPM0L2228
```

## soc/arm/ti_mspm0/mspm0l2xxx/Kconfig.defconfig.series
```kconfig
# TI MSPM0L2XXX

# Copyright (c) 2024 Texas Instruments
# SPDX-License-Identifier: Apache-2.0

if SOC_SERIES_MSPM0L2XXX

source "soc/arm/ti_mspm0/mspm0l2xxx/Kconfig.defconfig.mspm0l2*"

config SOC_SERIES
	default "mspm0l2xxx"

endif # SOC_SERIES_MSPM0L2XXX
```

## soc/arm/ti_mspm0/mspm0l2xxx/Kconfig.series
```kconfig
# TI MSPM0L2XXX

# Copyright (c) 2024 Texas Instruments
# SPDX-License-Identifier: Apache-2.0

config SOC_SERIES_MSPM0L2XXX
	bool "TI MSPM0 Family MSPM0L2XXX"
	select ARM
	select CPU_CORTEX_M0PLUS
	select CPU_CORTEX_M_HAS_VTOR
	select CPU_HAS_ARM_MPU
	select SOC_FAMILY_TIMSPM0
	select CPU_CORTEX_M_HAS_SYSTICK
	help
	  Enable support for TI MSPM0L2XXX.
```

## soc/arm/ti_mspm0/mspm0l2xxx/Kconfig.soc
```kconfig
# Texas Instruments MSPM0L2228

# Copyright (c) 2024 Texas Instruments
# SPDX-License-Identifier: Apache-2.0

choice
	prompt "TI MSPM0 MCU Selection"
	depends on SOC_SERIES_MSPM0L2XXX

config SOC_MSPM0L2228
	bool "MSPM0L2228"
endchoice
```

## soc/ti/mspm0/mspm0g1x0x_g3x0x/Kconfig.defconfig.mspm0g350x
```kconfig
# TI MSPM0G350X SoC

# Copyright (c) 2024 Texas Instruments
# SPDX-License-Identifier: Apache-2.0

if SOC_MSPM0G350X

config SOC
	default "mspm0g350x"

config NUM_IRQS
	default 32

endif # SOC_MSPM0G350X
```

## soc/ti/mspm0/mspm0gx51x/Kconfig.soc
```kconfig
# Copyright (c) 2024 Texas Instruments
# SPDX-License-Identifier: Apache-2.0

config SOC_SERIES_MSPM0GX51X
	bool
	select SOC_FAMILY_TI_MSPM0
	help
	  Enable support for TI MSPM0GX51X SoCs

config SOC_MSPM0G3519
	bool
	select SOC_SERIES_MSPM0GX51X

config SOC_SERIES
	default "mspm0gx51x" if SOC_SERIES_MSPM0GX51X

config SOC
	default "mspm0g3519" if SOC_MSPM0G3519
```

## soc/ti/mspm0/mspm0l122x_l222x/Kconfig.defconfig
```kconfig
# TI MSPM0L2XXX

# Copyright (c) 2024 Texas Instruments
# SPDX-License-Identifier: Apache-2.0

if SOC_SERIES_MSPM0L122X_L222X

rsource "Kconfig.defconfig.mspm0l*"

endif # SOC_SERIES_MSPM0L122X_L222X
```
