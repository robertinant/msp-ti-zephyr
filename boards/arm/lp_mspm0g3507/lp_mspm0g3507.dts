/* SPDX-License-Identifier: Apache-2.0 */

/dts-v1/;

#include <ti/mspm0g3507.dtsi>

/ {
	model = "TI LP_MSPM0G3507";
	compatible = "ti,lp_mspm0g3507","ti,mspm0g3507",
						"ti,mspm0g3xxx";

	chosen {
		zephyr,sram = &sram0;
		zephyr,flash = &flash0;
		zephyr,console = &uart0;
		zephyr,shell-uart = &uart0;
	};
};

&cpu0 {
	clock-frequency = <32000000>;
};

&uart0 {
	status = "okay";
	current-speed = <9600>;
};
